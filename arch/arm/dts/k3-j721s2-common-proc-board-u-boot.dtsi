// SPDX-License-Identifier: GPL-2.0
/*
 * Copyright (C) 2021-2023 Texas Instruments Incorporated - https://www.ti.com/
 */

#include "k3-j721s2-binman.dtsi"

&ospi1 {
	status = "disabled";
};

&usb0 {
	dr_mode = "peripheral";
};
