// SPDX-License-Identifier: GPL-2.0
/*
 * Copyright (C) 2020-2023 Texas Instruments Incorporated - https://www.ti.com/
 */

#include "k3-j7200-binman.dtsi"

&usbss0 {
	ti,usb2-only;
};

&usb0 {
	dr_mode = "peripheral";
};
