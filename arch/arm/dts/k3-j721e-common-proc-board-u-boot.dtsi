// SPDX-License-Identifier: GPL-2.0
/*
 * Copyright (C) 2018 Texas Instruments Incorporated - https://www.ti.com/
 */

#include "k3-j721e-binman.dtsi"

&usb0 {
	dr_mode = "peripheral";
};

&wkup_uart0 {
	status = "okay";
};

&wkup_i2c0 {
	status = "okay";
};
