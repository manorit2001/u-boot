// SPDX-License-Identifier: GPL-2.0
/*
 * Copyright (C) 2021 Texas Instruments Incorporated - https://www.ti.com/
 */

/dts-v1/;

#include "k3-j721e-sk.dts"
#include "k3-j721e-ddr-sk-lp4-4266.dtsi"
#include "k3-j721e-ddr.dtsi"
#include "k3-j721e-sk-u-boot.dtsi"

#include "k3-j721e-r5.dtsi"

&tps659413 {
	esm: esm {
		compatible = "ti,tps659413-esm";
		bootph-pre-ram;
	};
};

&wkup_vtm0 {
	vdd-supply-2 = <&bucka123>;
};

&ospi0 {
	/* Address change for data region (32-bit) */
	reg = <0x0 0x47040000 0x0 0x100>,
	      <0x0 0x50000000 0x0 0x8000000>;
};
